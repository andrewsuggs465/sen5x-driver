## sen5x/drivers/sensor/sen5x/Kconfig
```kconfig
# SPDX-License-Identifier: Apache-2.0

config SEN5X
	bool "Sensirion SEN5x environmental sensor"
	default y
	depends on DT_HAS_SENSIRION_SEN5X_ENABLED
	depends on SENSOR
	select I2C
	select CRC
	help
	  Enable driver for Sensirion SEN50/SEN54/SEN55.
```

## sen5x/dts/bindings/sensor/sensirion,sen5x.yaml
```yaml
# SPDX-License-Identifier: Apache-2.0

description: Sensirion SEN5x (SEN50/SEN54/SEN55) environmental sensor node

compatible: "sensirion,sen5x"

include: [sensor-device.yaml, i2c-device.yaml]
```
